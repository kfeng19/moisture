## main/Kconfig.projbuild
```kconfig
menu "Moisture Measurement Configuration"

    orsource "$IDF_PATH/examples/common_components/env_caps/$IDF_TARGET/Kconfig.env_caps"

    choice MEASUREMENT_DEPTH
        prompt "Sensor depth in soil"
        default SHALLOW_MEASUREMENT
        help
            Select the depth mode of sensor in soil

        config TIP_MEASUREMENT
            bool "TIP"
        config SHALLOW_MEASUREMENT
            bool "SHALLOW"
        config DEEP_MEASUREMENT
            bool "DEEP"
    endchoice

    choice MODE
        prompt "Operation mode"
        default DEPLOYMENT_MODE
        help
            Select the operation mode of the program

        config CALIBRATION_MODE
            bool "CALIB"
        config DEPLOYMENT_MODE
            bool "DEPLOY"
    endchoice


endmenu
```
